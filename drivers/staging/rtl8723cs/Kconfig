## drivers/staging/rtl8723cs/Kconfig
```kconfig
config RTL8723CS
	tristate "Realtek RTL8723CS SDIO or SPI WiFi driver"
	depends on WLAN && MMC && CFG80211
	select WIRELESS_EXT
	select WEXT_PRIV
	---help---
	  Help message of RTL8723CS
```
